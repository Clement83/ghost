#include <SPI.h>
#include <Gamebuino.h>
Gamebuino gb;

const byte Aiguille[] PROGMEM = {8,30,0x30,0x78,0xFC,0x30,0x30,0x30,0x30,0x30,0x30,0x30,0x30,0x30,0x30,0x30,0x30,0x30,0x30,0x30,0x30,0x30,0x30,0x30,0x30,0x30,0x30,0x30,0x30,0x30,0x30,0x30,};
const byte Screen[] PROGMEM = {88,48,0x0,0x3E,0x0,0x0,0x0,0x0,0x0,0x0,0x0,0x0,0x0,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0xC0,};


#define NB_TAB_IN  100
int input, prevInput;
int listDiffInput[NB_TAB_IN];
int cptIn = 0;
float angleCible, inputVar;
unsigned int cptFrame;
void setup(){
  gb.begin();
      TitleScreen();
  gb.setFrameRate(100);
}
void TitleScreen()
{
  gb.titleScreen(F("Ghost detector"));
  for(int i=0; i <NB_TAB_IN;i++)
  {
    listDiffInput[i] = 0;
  }
      
}
void loop(){
  if(gb.update()){
     
    if (gb.buttons.pressed(BTN_C)){
      TitleScreen();
    }

    input = gb.backlight.ambientLight;
    listDiffInput[cptIn] = abs(prevInput - input);
    cptIn++;
    cptIn = cptIn%NB_TAB_IN;//on depasse pas les 100
    prevInput = input;
    
    gb.display.drawBitmap(0,0,Screen);
    
    inputVar = moyenneDiffInput()*10;
    float valeurCible = (((float)min(inputVar, 24))/10.0);
    if(angleCible != valeurCible)
    {
      angleCible = angleCible<valeurCible? angleCible+=0.1 : angleCible-=0.1; 
    }
      drawBitmapAngle(43,58,Aiguille,(angleCible-1.2));

    
    if(angleCible > 1.9)
      gb.sound.playTick();
  }
}

float moyenneDiffInput()
{
  int somme = 0;
  for(int i=0; i <NB_TAB_IN;i++)
  {
    somme += listDiffInput[i];
  }
  return ((float)somme)/((float)NB_TAB_IN);
}

void drawBitmapAngle(int8_t x, int8_t y, const uint8_t *bitmap,const float angle) {
   int w = pgm_read_byte(bitmap);
   int h = pgm_read_byte(bitmap + 1);
        int centerX = w/2;
        int centerY = h+5;
   bitmap = bitmap + 2; //add an offset to the pointer to start after the width and height
    int i, j, byteWidth = (w + 7) / 8;
    for (j = 0; j < h; j++) {
        for (i = 0; i < w; i++) {
            if (pgm_read_byte(bitmap + j * byteWidth + i / 8) & (B10000000 >> (i % 8))) {
              
              int desX =   (i - centerX) * cos(angle) - (j-centerY) * sin(angle);
              int desY = (i-centerX) * sin(angle) + (j-centerY) * cos(angle);
              gb.display.drawPixel(x + desX, y + desY);
            }
        }
    }
}
